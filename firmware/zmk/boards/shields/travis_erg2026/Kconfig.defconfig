## firmware/zmk/boards/shields/travis_erg2026/Kconfig.defconfig
```kconfig
if SHIELD_TRAVIS_ERG2026

# Name must be less than 16 characters long!
config ZMK_KEYBOARD_NAME
    default "Travis Erg2026"

endif

# ---------------------
# Kconfig for shield "travis_erg2026" with board "rpi_pico"
# ---------------------
if BOARD_RPI_PICO && SHIELD_TRAVIS_ERG2026

config I2C
    default y

config ZMK_DISPLAY
    default y

if ZMK_DISPLAY

config I2C
    default y

config SSD1306
    default y

endif # ZMK_DISPLAY

if LVGL

config LV_Z_VDB_SIZE
    default 64

config LV_DPI_DEF
    default 148

config LV_Z_BITS_PER_PIXEL
    default 1

choice LV_COLOR_DEPTH
    default LV_COLOR_DEPTH_1
endchoice

endif # LVGL

endif
```

## firmware/zmk/boards/shields/travis_erg2026/Kconfig.shield
```kconfig
config SHIELD_TRAVIS_ERG2026
    def_bool $(shields_list_contains,travis_erg2026)
```
